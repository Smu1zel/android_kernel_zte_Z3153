## drivers/misc/mediatek/thermal/Kconfig
```kconfig
config MTK_THERMAL_PA_VIA_ATCMD
	bool "Thermal switch for query modem RF temp"
	help
	  Internal switch for thermal management
	  to query modem RF temperature
	  via AT command.
	  (RIL sockets)
config ZTE_THERMAL_INPUTCHARGER_LIMIT
	bool "Switch battery charger to input charger when thermal limit"
config ZTE_THERMAL_CHARGER_LIMIT_DUAL
	bool "Enable bcct to limit both main_charger and slave_charger"
	help
	  Enable this config and you can use abcct_2nd(_lcmoff)
	  as another cooler to bind on another TZ.
	  It also can used on single charger IC project.
```

## drivers/vendor/soc/mediatek/fingerprint/cdfinger/Kconfig
```kconfig
#
# CDFINGER Fingerprint driver configuration
#

config MTK_FINGERPRINT_CDFINGER
	bool "FPS Fingerprint"
	default n
	---help---
	Egis Fingerprint chip FPS980S TEE driver
```

## kernel-4.9/drivers/misc/mediatek/sensors-1.0/situation/sar/Kconfig
```kconfig
config CUSTOM_KERNEL_SAR_SENSOR
	bool "CUSTOM KERNEL SAR SENSOR for MediaTek package"
	default n
	help
	  A sar is a device,
	  usually portable and electronic
	  or electromechanical,
	  that detect distance between the body and device .

source "drivers/misc/mediatek/sensors-1.0/situation/sar/sx932x/Kconfig"
source "drivers/misc/mediatek/sensors-1.0/situation/sar/sx932x_2/Kconfig"
source "drivers/misc/mediatek/sensors-1.0/situation/sar/sarhub/Kconfig"
```

## kernel-4.9/drivers/misc/mediatek/sensors-1.0/situation/sar/sx932x/Kconfig
```kconfig
config CUSTOM_SX932X
	bool "CUSTOM KERNEL SAR sx932x Config"
	default n
	help
	  A sar is a device,
	  usually portable and electronic
	  or electromechanical,
	  that detect distance between the body and device .
```

## kernel-4.9/drivers/misc/mediatek/sensors-1.0/situation/sar/sx932x_2/Kconfig
```kconfig
config CUSTOM_SX932X_2
	bool "CUSTOM 2nd KERNEL SAR sx932x Config"
	default n
	help
	  A sar is a device,
	  usually portable and electronic
	  or electromechanical,
	  that detect distance between the body and device .
```

## kernel-4.9/drivers/vendor/soc/mediatek/Kconfig
```kconfig
#
# Kconfig for the mediatek kernel device drivers.
#

#Goodix
source "drivers/vendor/soc/mediatek/fingerprint/goodix/Kconfig"

#Silead
source "drivers/vendor/soc/mediatek/fingerprint/silead/Kconfig"

#Cdfinger
source "drivers/vendor/soc/mediatek/fingerprint/cdfinger/Kconfig"

source "drivers/vendor/soc/mediatek/fingerprint/egis/Kconfig"

#fortsense
source "drivers/vendor/soc/mediatek/fingerprint/fortsense/Kconfig"
```

## kernel-4.9/drivers/vendor/soc/mediatek/fingerprint/silead/Kconfig
```kconfig
#
# Silead Fingerprint driver configuration
#

config MTK_FINGERPRINT_SILEAD
	tristate "Silead Fingerprint driver support"
	default n
	help
		This supports Silead Fingerprint drivers.
```

## sound/soc/codecs/aw8898/Kconfig
```kconfig
config ZTE_AW8898_SMART_PA
	tristate "SoC Audio for awinic aw8898 series"
	depends on I2C
	help
	  This option enables support for aw8898 series Smart PA.
```
